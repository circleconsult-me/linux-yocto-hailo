## drivers/gpu/drm/hailo/Kconfig
```kconfig
# SPDX-License-Identifier: GPL-2.0

config DRM_HAILO
	tristate "HAILO Display"
	depends on DRM
	select DRM_KMS_HELPER
	select DRM_KMS_CMA_HELPER
	help
	  This is a DRM display driver for HAILO Displays or display
	  adapters.

	  If M is selected the module will be called hailo.
```

## drivers/phy/hailo/Kconfig
```kconfig
# SPDX-License-Identifier: GPL-2.0-only
#
# Phy drivers for Hailo platforms
#

config PHY_HAILO_TORRENT
	tristate "Hailo15 Cadence Torrent Multi-Protocol PHY support"
	depends on OF && ARCH_HAILO15 || COMPILE_TEST
	depends on OF_ADDRESS
	depends on COMMON_CLK
	default PHY_CADENCE_TORRENT
	help
	  This option enables support for the Cadence Torrent Multi-Protocol PHY wrapper
	  found on Hailo15 SoC, used for PCIe and USB3.
```
